## CMakeLists.txt
```
cmake_minimum_required(VERSION 3.20.0)

# Set XNNPACK directory
set(XNNPACK_DIR $ENV{ZEPHYR_BASE}/../../third-party/XNNPACK)

# Set XNNPACK build options (disable tests and benchmarks for faster builds)
set(XNNPACK_ENABLE_RISCV_VECTOR ON CACHE BOOL "Build XNNPACK with RISC-V Vector micro-kernels")
set(XNNPACK_BUILD_TESTS OFF CACHE BOOL "Build XNNPack unit tests")
set(XNNPACK_BUILD_BENCHMARKS OFF CACHE BOOL "Build XNNPack benchmarks")

# Configuration files
set(CONF_FILE prj.conf riscv_vector.conf)

# Find Zephyr
find_package(Zephyr REQUIRED HINTS $ENV{ZEPHYR_BASE})
project(rvv_bench)

# Build XNNPACK as a subproject (this builds pthreadpool automatically)
add_subdirectory(${XNNPACK_DIR} xnnpack_build)

# Create interface library to pass compile flags to pthreadpool
add_library(compile_commands INTERFACE)
target_include_directories(compile_commands INTERFACE $<TARGET_PROPERTY:app,INTERFACE_INCLUDE_DIRECTORIES>)
target_compile_options(compile_commands INTERFACE $<TARGET_PROPERTY:app,INTERFACE_COMPILE_OPTIONS>)
target_compile_definitions(compile_commands INTERFACE $<TARGET_PROPERTY:app,INTERFACE_COMPILE_DEFINITIONS>)
add_dependencies(compile_commands zephyr_interface)
add_dependencies(compile_commands zephyr_property_target)
target_link_libraries(pthreadpool PUBLIC compile_commands)

# Add XNNPACK include directories
target_include_directories(app PRIVATE ${XNNPACK_DIR})
target_include_directories(app PRIVATE ${XNNPACK_DIR}/include)
target_include_directories(app PRIVATE ${XNNPACK_DIR}/src)

# Link XNNPACK and pthreadpool
target_link_libraries(app PRIVATE XNNPACK pthreadpool)

# Add source files (kernel is embedded in main.c)
target_sources(app PRIVATE src/main.c)

# Enable RVV intrinsics
target_compile_options(app PRIVATE -march=rv64gcv
-O3
-ftree-vectorize
-fopt-info-vec-all)
```

## prj.conf
```kconfig
CONFIG_THREAD_STACK_INFO=y
CONFIG_MP_MAX_NUM_CPUS=1
CONFIG_SMP=y
CONFIG_MAIN_STACK_SIZE=16384
CONFIG_THREAD_STACK_MEM_MAPPED=y
CONFIG_DYNAMIC_THREAD=y
CONFIG_DYNAMIC_THREAD_STACK_SIZE=16384
CONFIG_DYNAMIC_THREAD_ALLOC=y
CONFIG_RISCV_ISA_EXT_V=y



CONFIG_SCHED_CPU_MASK=y
CONFIG_SCHED_CPU_MASK_PIN_ONLY=n
CONFIG_SCHED_DUMB=y



CONFIG_POSIX_API=y
CONFIG_MULTITHREADING=y
CONFIG_POSIX_THREADS=y

CONFIG_FPU=y
CONFIG_HEAP_MEM_POOL_SIZE=1048576

CONFIG_GNU_C_EXTENSIONS=y
CONFIG_CPP=y
CONFIG_STD_C17=y
CONFIG_STD_CPP20=y
CONFIG_GLIBCXX_LIBCPP=y
CONFIG_PICOLIBC=y
# CONFIG_NEWLIB_LIBC=y
# CONFIG_REQUIRES_FULL_LIBC=y
# CONFIG_REQUIRES_FULL_LIBCPP=y
CONFIG_COMMON_LIBC_MALLOC=y
CONFIG_COMMON_LIBC_MALLOC_ARENA_SIZE=67108864
# CONFIG_LOG=y
# CONFIG_THREAD_CUSTOM_DATA=y
# CONFIG_OBJ_CORE=y
```

## src/main.c
```c
#include <stdio.h>
#include <zephyr/sys/reboot.h>

int main(void)
{
        // Print to the host via TSI
        printf("Hello World! %s\n", CONFIG_BOARD_TARGET);

        // Send an exit command to the host to terminate the simulation
        sys_reboot(SYS_REBOOT_COLD);
        return 0;
}
```
